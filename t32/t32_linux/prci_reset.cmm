
Data.Set MD:0x10000000 %LE %Long 0xC0000000
Data.Set MD:0x10000004 %LE %Long 0x030187C1
Data.Set MD:0x10000008 %LE %Long 0x00000000
Data.Set MD:0x1000000C %LE %Long 0x030187C1

Data.Set MD:0x10000010 %LE %Long 0x00000000
Data.Set MD:0x10000014 %LE %Long 0x00000000
Data.Set MD:0x10000018 %LE %Long 0x00000000
Data.Set MD:0x1000001C %LE %Long 0x030187C1


Data.Set MD:0x10000020 %LE %Long 0x00000000
Data.Set MD:0x10000024 %LE %Long 0x00000001
Data.Set MD:0x10000028 %LE %Long 0x00000000
Data.Set MD:0x1000002C %LE %Long 0x00000004

Data.Set MD:0x10000030 %LE %Long 0x00000000
Data.Set MD:0x10000034 %LE %Long 0x00000000
Data.Set MD:0x10000038 %LE %Long 0x030187C1
Data.Set MD:0x1000003C %LE %Long 0x00000000


Data.Set MD:0x10000040 %LE %Long 0x00000000
Data.Set MD:0x10000044 %LE %Long 0x00000000
Data.Set MD:0x10000048 %LE %Long 0x00000000
Data.Set MD:0x1000004C %LE %Long 0x00000000


Data.Set MD:0x10000050 %LE %Long 0x030187C1
Data.Set MD:0x10000054 %LE %Long 0x00000000
Data.Set MD:0x10000058 %LE %Long 0x00000001
Data.Set MD:0x1000005C %LE %Long 0x00000000
