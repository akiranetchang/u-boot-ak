## drivers/clk/pi/Kconfig
```kconfig
# SPDX-License-Identifier: GPL-2.0

config CLK_PI
	bool "PI SoC driver support"
	depends on CLK
	help
	  SoC drivers for PI Linux-capable SoCs.

config CLK_PI_PRCI
	bool "PRCI driver for PI SoCs"
	depends on CLK_PI
	select CLK_ANALOGBITS_WRPLL_CLN28HPC
	help
	  Supports the Power Reset Clock interface (PRCI) IP block found in
	  PI A88 SoCs. If this kernel is meant to run on a PI 
	  A88 SoCs, enable this driver.
```

## drivers/ram/pi/Kconfig
```kconfig
config RAM_PI
	bool "Ram drivers support for SiFive SoCs"
	depends on RAM && RISCV
	default y
	help
	  This enables support for ram drivers of SiFive SoCs.

config PI_DDR
	bool "PI DDR driver"
	depends on RAM_PI
	default y if TARGET_PI_B88
	help
	  This enables DDR support for the platforms based on PI SoC.
```
